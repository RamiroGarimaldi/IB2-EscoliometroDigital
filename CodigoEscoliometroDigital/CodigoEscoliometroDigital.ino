#include <ESP8266WiFi.h>
#include <Wire.h>
#include <Adafruit_MPU6050.h>
#include <Adafruit_Sensor.h>
#include <Adafruit_GFX.h>
#include <Adafruit_SH110X.h>

#define i2c_Address 0x3c // Dirección I2C del OLED
#define SCREEN_WIDTH 128
#define SCREEN_HEIGHT 64
#define OLED_RESET -1
Adafruit_SH1106G display = Adafruit_SH1106G(SCREEN_WIDTH, SCREEN_HEIGHT, &Wire, OLED_RESET);
Adafruit_MPU6050 mpu;
#define BOTON D6
#define BOTON_C D5
#define BUZZER D7
bool estadoBoton = LOW;
bool estadoAnterior = LOW;
bool estadoBoton_C = LOW;
bool estadoAnterior_C = LOW;

//Funciones
void mensajeBienvenida(int x, int y);
void conectarMPU();
void conectarWiFi();
void conectarServidor();
void mostrarProgreso(const char* componente, const char* estado);
void mostrarWifi(int x, int y);
void mostrarServidor(int x, int y);
void calibrar();
float AnguloZ();
float promedioAnguloZ(int cantidadLecturas);
void tonoMed();

// CASA
//const char* ssid = "Gap-Wifi-2.4G";
//const char* password = "K25IHI78GVOO";
//const char* serverIP = "192.168.1.15";

//Datos
const char* ssid = "iPhone (9)";
const char* password = "rami2001";
const char* serverIP = "172.20.10.9";

int port = 5055;
WiFiServer server(port);
int contWiFi = 0;
bool WiFiConectado = false;
int fila = 0;
int enviodatos = 0;
String dataBuffer = "";
volatile bool isConnected = false;
bool guardarDatos = false;
float zFiltro = 0.0;
unsigned long tiempoAnteriorFiltro = 0;
unsigned long tiempoAnterior = 0; 
const unsigned long intervalo = 500;
float tiempoMed = 0.0;
float intervaloMed = 0.5;  
float offset = 0;
unsigned long ultimoChequeoWifi = 0;
const unsigned long intervaloChequeo = 5000;
bool intentandoReconectar = false;
bool intentandoReconectarServidor = false;
bool conexionServidorActiva = false;
unsigned long tiempoInicioReconexion = 0;
unsigned long TRecServidor = 0;
int med = 0;
unsigned long tiempoLectura_c = 0;
const unsigned long EvitarRebote = 50;
float offsetZ = 0.0;
float sumaAngulos = 0.0;
int contadorLecturas = 0;
unsigned long ultimoTiempoMuestreo = 0;
unsigned long ultimoTiempoVisualizacion = 0;
const unsigned long intervaloMuestreo = 100; 
const unsigned long intervaloVisualizacion = 500;
float ultimoPromedio = 0.0;

WiFiClient client;

//https://jlamch.net/MXChipWelcome/
const unsigned char WifiIcon [] PROGMEM = {
	0x00, 0x00, 0x00, 0x00, 0x00, 0x00, 0x00, 0x00, 0x00, 0x00, 0x00, 0x00, 0x03, 0xfc, 0x00, 0x0e, 
	0x07, 0x00, 0x18, 0x01, 0x80, 0x33, 0xf8, 0xc0, 0x07, 0x0e, 0x00, 0x0c, 0x03, 0x00, 0x00, 0xf0, 
	0x00, 0x01, 0x98, 0x00, 0x00, 0x00, 0x00, 0x00, 0x60, 0x00, 0x00, 0x60, 0x00, 0x00, 0x00, 0x00, 
	0x00, 0x00, 0x00, 0x00, 0x00, 0x00, 0x00, 0x00, 0x00, 0x00, 0x00, 0x00
};
const unsigned char NoWifiIcon [] PROGMEM = {
  0xff, 0xff, 0xf0, 0xff, 0xff, 0xf0, 0xff, 0xff, 0xf0, 0xff, 0xff, 0x70, 0xff, 0xfe, 0x70, 0xfc, 
  0x00, 0xf0, 0xf1, 0xf8, 0xf0, 0xe7, 0xf2, 0x70, 0xcc, 0x07, 0x30, 0xf9, 0xc9, 0xf0, 0xf3, 0x9c, 
  0xf0, 0xff, 0x07, 0xf0, 0xfe, 0x73, 0xf0, 0xfc, 0xff, 0xf0, 0xf9, 0x9f, 0xf0, 0xf3, 0x9f, 0xf0, 
  0xff, 0xff, 0xf0, 0xff, 0xff, 0xf0, 0xff, 0xff, 0xf0, 0xff, 0xff, 0xf0
};
const unsigned char Logotipo [] PROGMEM = {
  0x00, 0x00, 0x00, 0x00, 0x00, 0x00, 0x00, 0x00, 0x00, 0x00, 0x00, 0x00, 0x00, 0x00, 0x00, 0x00, 
  0x00, 0x00, 0x00, 0x00, 0x00, 0x00, 0x00, 0x00, 0x00, 0x00, 0x00, 0x00, 0x00, 0x00, 0x00, 0x00, 
  0x00, 0x00, 0x00, 0x00, 0x00, 0x00, 0x00, 0x00, 0x00, 0x00, 0x00, 0x00, 0x00, 0x00, 0x00, 0x00, 
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  0x00, 0x00, 0x00, 0x00, 0x00, 0x00, 0x00, 0x00, 0x00, 0x00, 0x00, 0x00, 0x00, 0x00, 0x00, 0x00
};
const unsigned char ServidorIcon [] PROGMEM = {
  0x00, 0x00, 0x00, 0x00, 0x00, 0x00, 0x00, 0x00, 0x00, 0x3f, 0xff, 0xc0, 0x20, 0x00, 0x40, 0x20, 
  0x00, 0x40, 0x20, 0x00, 0x40, 0x20, 0x00, 0x40, 0x20, 0x00, 0x40, 0x20, 0x00, 0x40, 0x20, 0x00, 
  0x40, 0x20, 0x00, 0x40, 0x20, 0x00, 0x40, 0x3f, 0xff, 0xc0, 0x00, 0x90, 0x00, 0x03, 0xfc, 0x00, 
  0x03, 0xfc, 0x00, 0x00, 0x00, 0x00, 0x00, 0x00, 0x00, 0x00, 0x00, 0x00
};
const unsigned char NoServidorIcon [] PROGMEM = {
  0xff, 0xff, 0xf0, 0xff, 0xff, 0xf0, 0xff, 0xff, 0xd0, 0xc0, 0x00, 0x10, 0xdf, 0xfe, 0x30, 0xdf, 
  0xfc, 0xb0, 0xdf, 0xf1, 0xb0, 0xdf, 0xe3, 0xb0, 0xdf, 0xc7, 0xb0, 0xdf, 0x1f, 0xb0, 0xde, 0x3f, 
  0xb0, 0xd8, 0x7f, 0xb0, 0xd1, 0xff, 0xb0, 0xc0, 0x00, 0x30, 0x8f, 0x6f, 0xf0, 0x9c, 0x03, 0xf0, 
  0xfc, 0x03, 0xf0, 0xff, 0xff, 0xf0, 0xff, 0xff, 0xf0, 0xff, 0xff, 0xf0
};

void setup() {
  Serial.begin(115200);
  Wire.begin();  //D1 = SCL, D2 = SDA
  pinMode(BOTON, INPUT);
  pinMode(BOTON_C, INPUT);
  pinMode(BUZZER, OUTPUT);

// Inicializacion display
  if (!display.begin(i2c_Address, true)) {  
    Serial.println("No se encontró la pantalla OLED. Verifica las conexiones.");
    display.clearDisplay();
    display.setTextSize(1);
    display.setTextColor(SH110X_WHITE);
    display.setCursor(0, 0);
    display.println("Error: OLED no detectado");
    display.display();
    while (1);  // Detener si no hay pantalla
  }
  display.setTextSize(1); 
  display.setTextColor(SH110X_WHITE);

  display.clearDisplay();
  mensajeBienvenida(0, 0);
  display.display();
  delay(5000);

  display.clearDisplay();
  conectarMPU();
  conectarWiFi();
  conectarServidor();
  calibrar();
  estadoBoton = LOW;
}

void loop() {
  float anguloZ = AnguloZ();
  float z = anguloZ - offsetZ;
  
  estadoBoton_C = digitalRead(BOTON_C);
  if(estadoBoton_C == LOW && estadoAnterior_C == HIGH){
    if(millis() - tiempoLectura_c > EvitarRebote){
      tone(BUZZER, 1000, 300);
      calibrar();
      tiempoLectura_c = millis();
    }
  }
  estadoAnterior_C = estadoBoton_C;

  estadoBoton = digitalRead(BOTON);
  if (estadoBoton == LOW && estadoAnterior == HIGH) { 
        if(!conexionServidorActiva){
          Serial.println("Intentando reconectar...");
          client.stop();
          if(client.connect(serverIP, port)){
            Serial.println("Reconectado exitosamente al servidor.");
            conexionServidorActiva = true;
            intentandoReconectarServidor = false;
          } else{
            Serial.println("Falló reconexión manual");
          }
        } else{
          guardarDatos = !guardarDatos; 
          Serial.println(guardarDatos ? "Recolección iniciada" : "Recolección detenida");
          tonoMed();
        }
    }
  estadoAnterior = estadoBoton; 

  if(millis() - ultimoChequeoWifi >= intervaloChequeo){
    ultimoChequeoWifi = millis();
    if(WiFi.status() != WL_CONNECTED && !intentandoReconectar){
      Serial.println("WiFi desconectado, intentando reconectar...");
      WiFi.disconnect();
      WiFi.begin(ssid, password);
      intentandoReconectar = true;
      tiempoInicioReconexion = millis();
    }
  }

  if(intentandoReconectar){
    if(WiFi.status() == WL_CONNECTED){
      Serial.println("Reconectado correctamente!");
      intentandoReconectar = false;
    } else if(millis() - tiempoInicioReconexion >= intervaloChequeo){
      Serial.println("No se pudo reconectar.");
      intentandoReconectar = false;
    }
  }
  
  if (millis() - tiempoAnterior >= intervalo) {
    tiempoAnterior = millis();

    display.clearDisplay();
    display.setTextSize(3);
    display.setTextColor(SH110X_WHITE);

    String angulo = String(z, 2);
    int ancho = angulo.length()*18;
    int x = (display.width() - ancho) / 2;
    int y = ((display.height() - 24) / 2) + 15;
    display.setCursor(x, y);
    display.println(angulo);

    mostrarWifi(81, 0);
    mostrarServidor(106, 0);

    if(guardarDatos){
      String tiempoStr = String(tiempoMed, 1);
      String anguloStr = String(z, 2);
      dataBuffer += "(" + tiempoStr + "," + anguloStr + ")";  
      Serial.print("Guardado: ");
      Serial.println(z, 2);
      tiempoMed += intervaloMed;
      display.setTextSize(1);
      display.setCursor(0, 0);
      display.print("Registrando");
      display.setCursor(0, 7);
      display.print("datos ...");
      enviodatos++;
    }
  }

  display.display();

  if (!client.connected() && conexionServidorActiva) {
  Serial.println("Servidor desconectado inesperadamente.");
  conexionServidorActiva = false;
  }

  if (!guardarDatos && enviodatos > 0) {
        client.println(dataBuffer);
        Serial.println("Enviando datos...");
        Serial.println(dataBuffer);
        tiempoMed = 0.0;
        dataBuffer = "";
        enviodatos = 0;
    }
}


void mensajeBienvenida(int x, int y){
  display.drawBitmap(x, y, Logotipo, 128, 64, 1);
}

void conectarMPU(){
  mostrarProgreso("MPU6050", "...");
  if (!mpu.begin()) {
    display.clearDisplay();
    mostrarProgreso("MPU6050", "Error");
    Serial.println("No se encontró el MPU6050");
    while (1);
  } else {
    display.clearDisplay();
    fila = 0;
    mostrarProgreso("MPU6050", "OK");
    delay(1000);
  }
}

void conectarWiFi() {
  WiFi.mode(WIFI_STA);
  WiFi.begin(ssid, password);
  unsigned long startMillis = millis();

  if(contWiFi == 0){
     mostrarProgreso("WiFi", "...");
  } else{
    display.clearDisplay();
    fila = 0;
    mostrarProgreso("MPU6050", "OK");
    mostrarProgreso("WiFi", "Reconectando..." );
  }

  contWiFi++;

  while (WiFi.status() != WL_CONNECTED && millis() - startMillis < 7000) {
    delay(500);
  }

  if (WiFi.status() == WL_CONNECTED) {
    display.clearDisplay();
    fila = 0;
    mostrarProgreso("MPU6050", "OK");
    mostrarProgreso("WiFi", "OK");
    WiFiConectado = true;
    display.setCursor(0, 20); 
    Serial.println(WiFi.localIP());
    display.display();
    display.display();
    delay(3000);
  } else {
    display.clearDisplay();
    fila = 0;
    mostrarProgreso("MPU6050", "OK");
    mostrarProgreso("WiFi", "No conectado");
    WiFiConectado = false;
    delay(2000);
    Serial.println("No se pudo conectar a la red Wi-Fi.");
  }
}

void conectarServidor(){
  mostrarProgreso("Servidor", "...");
  if (isConnected) {
    client.stop();
    isConnected = false;
    Serial.println("Conexión cerrada");
    } else {
      if (client.connect(serverIP, port)) {
      isConnected = true;
      conexionServidorActiva = true;
      Serial.println("Conexión abierta");
      display.clearDisplay();
      fila = 0;
      mostrarProgreso("MPU6050", "OK");
      if(WiFiConectado){
         mostrarProgreso("WiFi", "OK");
      } else{
         mostrarProgreso("WiFi", "No conectado");
      }
      mostrarProgreso("Servidor", "OK");
      delay(3000);
      } else {
        isConnected = false;
        conexionServidorActiva = false;
        Serial.println("Error al conectar");
        display.clearDisplay();
        fila = 0;
        mostrarProgreso("MPU6050", "OK");
        if(WiFiConectado){
          mostrarProgreso("WiFi", "OK");
        }else{
          mostrarProgreso("WiFi", "No conectado");
        }
        mostrarProgreso("Servidor", "No conectado");
        display.display();
        delay(5000);
      }
  }
}

float AnguloZ(){
  sensors_event_t a, g, temp;
  mpu.getEvent(&a, &g, &temp);

  unsigned long tiempoActual = millis();
  float dt = (tiempoActual - tiempoAnteriorFiltro) / 1000.0;
  tiempoAnteriorFiltro = tiempoActual;

  float zAcel = atan2(a.acceleration.y, a.acceleration.x) * 180 / PI;
  float velocidadZ = g.gyro.z;
  float alpha = 0.98;
  zFiltro = alpha * (zFiltro + velocidadZ * dt) + (1 - alpha) * zAcel;

  return zFiltro;
}

float promedioAnguloZ(int cantidadLecturas){
  float suma = 0;
  for(int i = 0; i < cantidadLecturas; i++){
    suma += AnguloZ();
    delay(50);
  }
  return suma / cantidadLecturas;
}

void calibrar(){
    zFiltro = 0;
    tiempoAnteriorFiltro = millis();
    
    display.setTextSize(1);
    display.clearDisplay();
    String titulo = "Calibracion";
    int textWidth = titulo.length() * 6;
    int xCenter = (128 - textWidth) / 2;
    display.setCursor(xCenter,0);
    display.println(titulo);
    display.setCursor(0,16);
    display.println("Coloque el equipo");
    display.setCursor(0,28);
    display.println("hacia el frente");
    display.setCursor(0,44);
    display.println("Aguarde el sonido...");
    display.display();
    delay(5000);
    float angulo1 = promedioAnguloZ(20);
    tone(BUZZER, 1000, 500);

    display.clearDisplay();
    display.setCursor(xCenter,0);
    display.println(titulo);
    display.setCursor(0,16);
    display.println("Coloque el equipo");
    display.setCursor(0,28);
    display.println("hacia atras");
    display.setCursor(0,44);
    display.println("Aguarde el sonido...");
    display.display();
    delay(5000);
    float angulo2 = promedioAnguloZ(20);
    tone(BUZZER, 1000, 500);

    offsetZ = (angulo1 + angulo2) / 2.0;

    display.clearDisplay();
    String titulo1 = "Calibracion";
    String titulo2 = "completada!";
    int textWidth1 = titulo1.length() * 6;
    int textWidth2 = titulo2.length() * 6;
    int totalHeight = 2 * 8 + 4;
    int yStart = (64 - totalHeight) / 2;

    int xCenter1 = (128 - textWidth1) / 2;
    display.setCursor(xCenter1, yStart);
    display.println(titulo1);
    int xCenter2 = (128 - textWidth2) / 2;
    display.setCursor(xCenter2, yStart + 8 + 4);
    display.println(titulo2);
    display.display();
    delay(2000);
}

void mostrarProgreso(const char* componente, const char* estado){
  display.setCursor(0, fila * 10);
  display.print(componente);
  display.print(" ");
  display.println(estado);
  display.display();
  fila++;
}

void mostrarWifi(int x, int y){
  if(WiFi.status() == WL_CONNECTED){
    display.drawBitmap(x, y, WifiIcon, 20, 20, 1);
  } else {
    display.drawBitmap(x, y, NoWifiIcon, 20, 20, 1);
  }
}

void mostrarServidor(int x, int y){
  if(conexionServidorActiva){
    display.drawBitmap(x, y, ServidorIcon, 20, 20, 1);
  } else {
    display.drawBitmap(x, y, NoServidorIcon, 20, 20, 1);
  }
}

void tonoMed() {
  if (med % 2 == 0) {
    tone(BUZZER, 1000, 300);
    delay(350);
  } else {
    for (int i = 0; i < 3; i++) {
      tone(BUZZER, 1000, 150);
      delay(200);
    }
  }
  med ++;
}